## conf/layer.conf
```bitbake
# We have a conf and classes directory, add to BBPATH
BBPATH .= ":${LAYERDIR}"

# We have recipes-* directories, add to BBFILES
BBFILES += "${LAYERDIR}/recipes-*/*/*.bb \
            ${LAYERDIR}/recipes-*/*/*.bbappend"

BBFILE_COLLECTIONS += "rdk-halif-headers"
BBFILE_PATTERN_rdk-halif-headers = "^${LAYERDIR}/"
BBFILE_PRIORITY_rdk-halif-headers = "6"

LAYERDEPENDS_rdk-halif-headers = "core"
LAYERSERIES_COMPAT_rdk-halif-headers = "dunfell kirkstone"
```
